## conf/machine/include/rv1103.inc
```bitbake
require conf/machine/include/arm/armv7a/tune-cortexa7.inc
require conf/machine/include/rockchip-common.inc

RK_SOC_FAMILY := "rv1103"
```

## conf/machine/include/rv1106.inc
```bitbake
require conf/machine/include/arm/armv7a/tune-cortexa7.inc
require conf/machine/include/rockchip-common.inc

RK_SOC_FAMILY := "rv1106"

KBUILD_DEFCONFIG := "rv1106_defconfig"
```
